## conf/layer.conf
```bitbake
# We have a conf and classes directory, add to BBPATH
BBPATH .= ":${LAYERDIR}"

# We have recipes-* directories, add to BBFILES
BBFILES += "${LAYERDIR}/recipes-*/*/*.bb \
            ${LAYERDIR}/recipes-*/*/*.bbappend"

BBFILE_COLLECTIONS += "meta-updater-ti"
BBFILE_PATTERN_meta-updater-ti = "^${LAYERDIR}/"
BBFILE_PRIORITY_meta-updater-ti = "7"
```
